/* SUPER MINIMAL TEST OVERLAY FOR APOGEE */

#include <dt-bindings/zmk/matrix_transform.h>

/ {
    /* Tell ZMK which kscan + transform to use */
    chosen {
        zmk,kscan = &kscan0;
        zmk,matrix-transform = &apogee_transform;
    };

    /* Tiny 1x1 matrix transform just so the DT is valid */
    apogee_transform: apogee_transform {
        compatible = "zmk,matrix-transform";
        rows = <1>;
        columns = <1>;
        map = <RC(0,0)>;
    };

    /* Minimal kscan node, no MCP23017, just 1 row + 1 col on GPIO0 */
    kscan0: kscan0 {
        compatible = "zmk,kscan-gpio-matrix";
        label = "APOGEE_KSCAN_MIN";

        diode-direction = "col2row";

        /* totally fake pins, just to make DT happy */
        row-gpios = <&gpio0 17 GPIO_ACTIVE_HIGH>;
        col-gpios = <&gpio0 6  GPIO_ACTIVE_HIGH>;
    };
};
