## boards/shields/apogee/Kconfig.shield
```kconfig
# SPDX-License-Identifier: MIT
config ZMK_KEYBOARD_NAME
    string
    default "APOGEE (matrix-only bringup)"
```

## config/boards/shields/Apogee/Kconfig.defconfig
```kconfig
# Shield-specific defaults for Apogee keyboard

config ZMK_KEYBOARD_NAME
    default "Apogee Keyboard"

# Enable the I2C-based MCP230xx GPIO expander driver
config GPIO_MCP230XX
    default y
```

## config/boards/shields/apogee/Kconfig.defconfig
```kconfig
# Copyright (c) 2024 The ZMK Contributors
# SPDX-License-Identifier: MIT

if SHIELD_APOGEE

config ZMK_KEYBOARD_NAME
    default "Apogee"

config ZMK_USB
    default y

config ZMK_BLE
    default y

# I2C for MCP23017 and OLED
config I2C
    default y

if # ZMK_DISPLAY

config EC11
    default y

endif # SHIELD_APOGEE
```

## config/boards/shields/apogee/Kconfig.shield
```kconfig
# Copyright (c) 2024 The ZMK Contributors
# SPDX-License-Identifier: MIT

config SHIELD_APOGEE
    def_bool $(shields_list_contains,apogee)
```

## dts/bindings/gpio/microchip,mcp23017.yaml
```yaml
# Microchip MCP23017 I2C GPIO expander binding for ZMK

description: >
  Microchip MCP23017 16-bit I2C GPIO expander used as a GPIO controller.

compatible: "microchip,mcp23017"

include:
  - gpio-controller.yaml
  - i2c-device.yaml

properties:
  "#gpio-cells":
    type: int
    const: 2
    description: Number of cells in a GPIO specifier.

  ngpios:
    type: int
    const: 16
    description: Number of GPIOs provided by the expander.

gpio-cells:
  - pin
  - flags
```

## west.yml
```yaml
# Copyright (c) 2024 The ZMK Contributors
# SPDX-License-Identifier: MIT

manifest:
  remotes:
    - name: zmkfirmware
      url-base: https://github.com/zmkfirmware
  projects:
    - name: zmk
      remote: zmkfirmware
      revision: main
      import: app/west.yml
  self:
    path: config
```
