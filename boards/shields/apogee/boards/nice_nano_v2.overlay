&pinctrl {
    i2c0_apogee: i2c0_apogee {
        group1 {
            psels = <NRF_PSEL(TWIM_SDA, 0, 6)>,
                    <NRF_PSEL(TWIM_SCL, 0, 8)>;
        };
    };
};

&i2c0 {
    status = "okay";

    pinctrl-0 = <&i2c0_apogee>;
    pinctrl-1 = <&i2c0_apogee>;
    pinctrl-names = "default", "sleep";
};
